#include <Arduino.h>
#include <BLEDevice.h>
#include <BLEUtils.h>
#include <BLEServer.h>
#include <BLE2902.h>
#include "images.h"
#include <Wire.h>
#include <HT_SSD1306Wire.h>
#include "DHT.h"

#define BLE_DEVICE_NAME "ESP32 BLE Sensor Server"
#define BLE_SERVICE_UUID "819dd7a4-c6c5-4c39-b10f-51e180eb1ffb" // Generated by https://www.uuidgenerator.net/ needs to be changed whenever the service is changed (eg characteristics added/removed)
#define BLE_WATER_TANK_CHARACTERISTIC_UUID "22d8381a-e6df-4ad1-a101-5e2e47c0762b"
#define BLE_SEPTIC_TANK_CHARACTERISTIC_UUID "9910102a-9d4e-41ce-be93-affba54425c4"
#define BLE_TEMPERATURE_CHARACTERISTIC_UUID "c6db06e1-7f34-48ff-9f1e-f2904ac78525"
#define BLE_HUMIDITY_CHARACTERISTIC_UUID "df2be7ec-fb73-40b6-b2cb-3c00d37f2229"
#define DHTTYPE DHT22 // DHT 22  (AM2302), AM2321
#define DHTPIN 47     // Digital pin connected to the DHT sensor

SSD1306Wire display(0x3c, 500000, SDA_OLED, SCL_OLED, GEOMETRY_128_64, RST_OLED); // addr , freq , i2c group , resolution , rst
DHT dht(DHTPIN, DHTTYPE);

bool deviceConnected = false;
uint8_t LED_PIN = 35;
uint8_t MOSFET_PIN = 48;           // Pin for the MOSFET controlling power to the 24V sensors
uint8_t septicTankLevel1_PIN = 33; // Pin for the septic tank sensor at level 1
uint8_t septicTankLevel2_PIN = 34; // Pin for the septic tank sensor at level 2

BLEServer *pServer = NULL;
BLEService *pService = NULL;
BLECharacteristic *pCharacteristicWaterTank = NULL;
BLECharacteristic *pCharacteristicSepticTank = NULL;
BLECharacteristic *pCharacteristicTemperature = NULL;
BLECharacteristic *pCharacteristicHumidity = NULL;

double waterTankLevel = 0.0;
double septicTankLevel = 0.0;
double temperature = 0.0;
double humidity = 0.0;

class BleSensorServerCallbacks : public BLEServerCallbacks
{
  void onConnect(BLEServer *pServer)
  {
    deviceConnected = true;
    display.drawXbm(128 - BT_width, 0, BT_width, BT_height, (const unsigned char *)BT_bits);
    display.display();
    Serial.println("Device connected!");
  };

  void onDisconnect(BLEServer *pServer)
  {
    Serial.println("Device disconnected");
    deviceConnected = false;
    display.setColor(INVERSE);
    display.drawXbm(128 - BT_width, 0, BT_width, BT_height, (const unsigned char *)BT_bits);
    display.display();
    display.setColor(INVERSE);
    delay(500);                  // give the bluetooth stack the chance to get things ready
    pServer->startAdvertising(); // restart advertising
    Serial.println("Re-start advertising " + String(BLE_DEVICE_NAME) + "...");
  }
};

BLECharacteristic *createCharacteristic(const char *uuid)
{
  BLECharacteristic *pCharacteristic = pService->createCharacteristic(uuid, BLECharacteristic::PROPERTY_READ | BLECharacteristic::PROPERTY_NOTIFY);
  BLE2902 *pBLE2902 = new BLE2902();
  pBLE2902->setNotifications(true);
  pCharacteristic->addDescriptor(pBLE2902);
  return pCharacteristic;
}

void setupBLE()
{
  Serial.println("Setting up BLE...");
  BLEDevice::init(BLE_DEVICE_NAME);
  // Create the BLE Server
  pServer = BLEDevice::createServer();
  pServer->setCallbacks(new BleSensorServerCallbacks());

  // Create the BLE Service
  pService = pServer->createService(BLE_SERVICE_UUID);

  // Create the BLE Characteristics
  // pCharacteristicWaterTank = createCharacteristic(BLE_WATER_TANK_CHARACTERISTIC_UUID);
  pCharacteristicSepticTank = createCharacteristic(BLE_SEPTIC_TANK_CHARACTERISTIC_UUID);
  pCharacteristicTemperature = createCharacteristic(BLE_TEMPERATURE_CHARACTERISTIC_UUID);
  pCharacteristicHumidity = createCharacteristic(BLE_HUMIDITY_CHARACTERISTIC_UUID);

  // Start the service
  pService->start();

  // Start advertising
  BLEAdvertising *pAdvertising = BLEDevice::getAdvertising();
  pAdvertising->addServiceUUID(BLE_SERVICE_UUID);
  pAdvertising->setScanResponse(false);
  // pAdvertising->setMinPreferred(0x06); // functions that help with iPhone connections issue
  // pAdvertising->setMinPreferred(0x12);
  BLEDevice::startAdvertising();

  Serial.println("BLE Setup Done. Started advertising " + String(BLE_DEVICE_NAME) + "...");
}

void setupDisplay()
{
  display.init();
  display.clear();
  display.display();
  display.setFont(ArialMT_Plain_16);
  display.drawString(0, 0, "Initiating...");
  display.display();
}

void setup()
{
  Serial.begin(115200);
  pinMode(LED_PIN, OUTPUT);
  pinMode(MOSFET_PIN, OUTPUT);
  pinMode(septicTankLevel1_PIN, INPUT);
  pinMode(septicTankLevel2_PIN, INPUT);

  digitalWrite(MOSFET_PIN, HIGH); // Turn on power to the sensors

  setupDisplay();
  setupBLE();

  digitalWrite(MOSFET_PIN, HIGH); // Turn on power to the sensors
}

void updateDisplay()
{
  display.clear();
  display.drawString(0, 0, "Septik: " + String(septicTankLevel, 0) + " %");
  // display.drawString(0, 0, "Vatten: " + String(waterTankLevel, 0) + " %");
  display.drawString(0, 16, "Temp: " + String(temperature, 0) + " C");
  display.drawString(0, 32, "Humidity: " + String(humidity, 0) + " %");
  if (deviceConnected)
  {
    display.drawXbm(128 - BT_width, 0, BT_width, BT_height, (const unsigned char *)BT_bits);
  }
  display.display();
}

void readDhtSensor()
{
  Serial.println("Reading DHT sensor...");

  dht.begin();

  // Reading temperature or humidity takes about 250 milliseconds!
  // Sensor readings may also be up to 2 seconds 'old' (its a very slow sensor)
  float h = dht.readHumidity();
  // Read temperature as Celsius (the default)
  float t = dht.readTemperature();

  // Check if any reads failed and exit early (to try again).
  if (isnan(h))
  {
    Serial.println("Failed to read humidity from DHT sensor!");
  }
  else
  {
    humidity = h;
  }

  if (isnan(t))
  {
    Serial.println("Failed to read temperature from DHT sensor!");
  }
  else
  {
    temperature = t;
  }

  Serial.println("Temperature: " + String(temperature) + " C");
}

void readSepticTankSensors()
{
  Serial.println("Reading septic tank sensors...");
  if (digitalRead(septicTankLevel2_PIN) == LOW)
  {
    septicTankLevel = 90.0;
  }
  else if (digitalRead(septicTankLevel1_PIN) == LOW)
  {
    septicTankLevel = 50.0;
  }
  else
  {
    septicTankLevel = 0.0;
  }
  Serial.println("Septic tank level: " + String(septicTankLevel) + " %");
}

void readSensors()
{
  // Serial.println("Powering on sensors...");
  // digitalWrite(MOSFET_PIN, HIGH); // Turn on power to the sensors

  // delay(1000); // Wait for the temp sensor to stabilize
  readDhtSensor();

  // delay(2000); // Wait for the septic tank sensor to stabilize
  readSepticTankSensors();

  // Read the water tank sensor
  // waterTankLevel = analogRead(waterTankLevel_PIN) / 4095.0 * 100.0;
  // waterTankLevel = random(0, 10000) / 100.0;
  // Serial.println("Water tank level: " + String(waterTankLevel) + " %");

  // digitalWrite(MOSFET_PIN, LOW); // Turn off power to the 24V sensors
  // Serial.println("Powering off sensors...");
}

void sendValue(BLECharacteristic *pCharacteristic, double value)
{
  pCharacteristic->setValue(value);
  pCharacteristic->notify();
  digitalWrite(LED_PIN, HIGH);
  delay(50);
  digitalWrite(LED_PIN, LOW);
  Serial.println("Sent value: " + String(value) + " to client for characteristic: " + pCharacteristic->getUUID().toString().c_str());
  delay(500); // bluetooth stack will go into congestion, if too many packets are sent so we need to slow down a bit
}

void sendAllValues()
{
  // sendValue(pCharacteristicWaterTank, waterTankLevel);
  sendValue(pCharacteristicSepticTank, septicTankLevel);
  sendValue(pCharacteristicTemperature, temperature);
  sendValue(pCharacteristicHumidity, humidity);
}

// put your main code here, to run repeatedly:
void loop()
{
  readSensors();

  updateDisplay();

  if (deviceConnected)
  {
    sendAllValues();
  }
  else
  {
    Serial.println("Skipping sending values to client as no client is connected...");
  }

  // delay 60 seconds
  delay(5 * 1000);
}